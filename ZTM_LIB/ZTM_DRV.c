/****************************************Copyright (c)****************************************************
**                            Guangzhou ZHIYUAN electronics Co.,LTD.
**
**                                 http://www.embedtools.com
**
**--------------File Info---------------------------------------------------------------------------------
** File name:           ZTM_DRV.c
** Last modified Date:  2011-06-03
** Last Version:        V1.0
** Descriptions:        添加LCD驱动库底层驱动函数
**
**--------------------------------------------------------------------------------------------------------
** Created by:          He Zengfu
** Created date:        2011-06-03
** Version:             V1.0
** Descriptions:        创建文件
**
**--------------------------------------------------------------------------------------------------------
** Modified by:         WangWenXiong
** Modified date:       2012-02-24
** Version:             V1.01
** Description:         无修改
**
**--------------------------------------------------------------------------------------------------------
** Modified by:
** Modified date:
** Version:
** Descriptions:
**
** Rechecked by:
*********************************************************************************************************/
//#include "includes.h"   
#include "ZTM.h"

/*********************************************************************************************************
  全局变量定义
*********************************************************************************************************/
INT8U       __GucRcvBuf[10];                                             /* 串口接收数据缓冲区           */
INT16S      GsKeyXY[2];                                                  /* 触摸屏获得的坐标值           */
INT8U  GucKeyFlag = 0;                                    /* 按键按下的标志 note volatile                 */

/*********************************************************************************************************
** 函数名称:  uartInit
** 函数功能:  串口初始化，设置为8位数据位，1位停止位，无奇偶校验
** 输入参数:  ulBaud：串口波特率
** 输出参数:  无
** 返 回 值:  无
*********************************************************************************************************/
void uartInit (INT32U ulBaud)
{
                                        /* 使能接收中断                 */
}

/*********************************************************************************************************
** 函数名称:  uartSendChar
** 函数功能:  向串口发送字节数据，并等待数据发送完成，使用查询方式
** 输入参数:  ucDat:    要发送的数据
** 输出参数:  无
** 返 回 值:  无
*********************************************************************************************************/
void uartSendBuff (INT8U ucDat[],INT16U len)
{
  INT32U i;
  while(ZTM_BusyStat())
  {
    i++;
  }  
	BSP_USART_Send(USART2,ucDat,len);
}

/*********************************************************************************************************
** 函数名称:  ZTM_Delay
** 函数功能:  延时函数
** 输入参数:  ulTime：  延时时间
** 输出参数:  无
** 返 回 值:  无
*********************************************************************************************************/
void ZTM_Delay (INT32U ulTime)
{
    INT32U i;

    i = 0;
    while (ulTime--) {
        for (i = 0; i < 5000; i++);
    }
}

/*********************************************************************************************************
** 函数名称:  UART0_IRQHandler
** 函数功能:  UART0 中断处理函数
** 输入参数:  无
** 输出参数:  将获取的触摸屏x，y坐标值保存到GsKeyXY数组中
** 返 回 值:  无
*********************************************************************************************************/
void UART0_IRQHandler (void)
{
}

/*********************************************************************************************************
** 函数名称:  ZTM_BusyStat
** 函数功能:  忙状态检测
** 输入参数:  无
** 输出参数:  无
** 返 回 值:  状态值 1：显示终端忙，0：显示终端空闲
*********************************************************************************************************/
INT8U ZTM_BusyStat (void)
{
#if BUSY_EN                                         /* 配置判忙引脚为输入模式       */
    if (BUSY_PIN_STATE() == 1) {
        return ZTM_BUSY;                            /* 串口屏正忙，返回1            */
    } else {
        return ZTM_FREE;                            /* 串口屏不忙，返回0            */
    }
#else
    return 0;                                       /* 不使能判忙信号，直接返回空闲 */
#endif
}
/*********************************************************************************************************
end  of file
*********************************************************************************************************/



